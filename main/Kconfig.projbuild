## main/Kconfig.projbuild
```kconfig
menu "Example Configuration"
    config EXAMPLE_WIFI_SSID
        string "WiFi SSID"
        default "myssid"
        help
            SSID (network name) for the device to connect to.

    config EXAMPLE_WIFI_PASSWORD
        string "WiFi Password"
        default "mypassword"
        help
            WiFi password (WPA or WPA2).

    config OTA_UPDATE_URL
        string "OTA Firmware URL"
        default "https://github.com/user/repo/releases/latest/download/firmware.bin"
        help
            URL for OTA updates.
endmenu
```
